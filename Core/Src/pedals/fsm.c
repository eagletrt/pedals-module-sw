/******************************************************************************
Finite State Machine
Project: fsm.dot
Description: pedals_fsm

Generated by gv_fsm ruby gem, see https://rubygems.org/gems/gv_fsm
gv_fsm version 0.5.2
Generation date: 2026-03-20 19:46:13 +0100
Generated from: fsm.dot
The finite state machine has:
  4 states
  0 transition functions

******************************************************************************/

#include "fsm.h"
#include "eagletrt-api.h"
#include "can-communications-api.h"
#include "brake-api.h"
#include "throttle-api.h"
#include "post-api.h"

#include "usart.h"
#include <string.h>

// SEARCH FOR Your Code Here FOR CODE INSERTION POINTS!
static void serial_write(const char *str) {
    HAL_UART_Transmit(&huart1, (const uint8_t *)str, (uint16_t)strlen(str), HAL_MAX_DELAY);
}

// GLOBALS
// State human-readable names
const char *state_names[] = { "init", "idle", "error", "flash" };

// List of state functions
state_func_t *const state_table[NUM_STATES] = {
    do_init,  // in state init
    do_idle,  // in state idle
    do_error, // in state error
    do_flash, // in state flash
};
// No transition functions

/*  ____  _        _       
 * / ___|| |_ __ _| |_ ___ 
 * \___ \| __/ _` | __/ _ \
 *  ___) | || (_| | ||  __/
 * |____/ \__\__,_|\__\___|
 *                         
 *   __                  _   _                 
 *  / _|_   _ _ __   ___| |_(_) ___  _ __  ___ 
 * | |_| | | | '_ \ / __| __| |/ _ \| '_ \/ __|
 * |  _| |_| | | | | (__| |_| | (_) | | | \__ \
 * |_|  \__,_|_| |_|\___|\__|_|\___/|_| |_|___/
 */

// Function to be executed in state init
// valid return states: STATE_IDLE, STATE_ERROR
state_t do_init(state_data_t *data) {
    state_t next_state = STATE_IDLE;
    /* Your Code Here */

    struct PostInit *init_struct = (struct PostInit *)data;
    //EAGLETRT_API_UNUSED(data);
    if (post_api_init(init_struct) != POST_RC_OK) {
        serial_write("Error: post_api_init failed in do_init\n\r");
        next_state = STATE_ERROR;
    } else {
        serial_write("post_api_init succeeded in do_init\n\r");
    }

    switch (next_state) {
        case STATE_IDLE:
        case STATE_ERROR:
            break;
        default:
            next_state = NO_CHANGE;
    }

    return next_state;
}

EAGLETRT_STATIC uint32_t last_throttle = 0;
EAGLETRT_STATIC uint32_t last_brake = 0;

// Function to be executed in state idle
// valid return states: NO_CHANGE, STATE_IDLE, STATE_FLASH, STATE_ERROR
state_t do_idle(state_data_t *data) {
    state_t next_state = NO_CHANGE;
    /* Your Code Here */

    if (data == NULL) {
        serial_write("Error: data is NULL in do_idle\n\r");
        return STATE_ERROR;
    }
    struct FsmIdleData *idle_struct = (struct FsmIdleData *)data;
    if (idle_struct->get_tick == NULL) {
        serial_write("Error: get_tick is NULL in do_idle\n\r");
        return STATE_ERROR;
    }

    if (idle_struct->get_tick() - last_throttle > 50) {
        serial_write("Sending throttle status\n\r");
        last_throttle = idle_struct->get_tick();
        if (throttle_api_send_status() != THROTTLE_RC_OK) {
            serial_write("Error: throttle_api_send_status failed in do_idle\n\r");
            next_state = STATE_ERROR;
        }
    }

    if (idle_struct->get_tick() - last_brake > 100) {
        serial_write("Sending brake status\n\r");
        last_brake = idle_struct->get_tick();
        if (brake_api_send_status() != BRAKE_RC_OK) {
            serial_write("Error: brake_api_send_status failed in do_idle\n\r");
            next_state = STATE_ERROR;
        }
    }

    can_communications_api_process_tx();
    can_communications_api_process_rx();

    switch (next_state) {
        case NO_CHANGE:
        case STATE_IDLE:
        case STATE_FLASH:
        case STATE_ERROR:
            break;
        default:
            next_state = NO_CHANGE;
    }

    return next_state;
}

// Function to be executed in state error
// valid return states: NO_CHANGE, STATE_ERROR
state_t do_error(state_data_t *data) {
    state_t next_state = NO_CHANGE;
    /* Your Code Here */

    EAGLETRT_API_UNUSED(data);
    serial_write("Error state reached. Please reset the system.\n\r");

    switch (next_state) {
        case NO_CHANGE:
        case STATE_ERROR:
            break;
        default:
            next_state = NO_CHANGE;
    }

    return next_state;
}

// Function to be executed in state flash
// valid return states: NO_CHANGE, STATE_IDLE, STATE_FLASH, STATE_ERROR
state_t do_flash(state_data_t *data) {
    state_t next_state = NO_CHANGE;
    /* Your Code Here */

    EAGLETRT_API_UNUSED(data);

    switch (next_state) {
        case NO_CHANGE:
        case STATE_IDLE:
        case STATE_FLASH:
        case STATE_ERROR:
            break;
        default:
            next_state = NO_CHANGE;
    }

    return next_state;
}

/*  ____  _        _        
 * / ___|| |_ __ _| |_ ___  
 * \___ \| __/ _` | __/ _ \
 *  ___) | || (_| | ||  __/ 
 * |____/ \__\__,_|\__\___| 
 *                          
 *                                              
 *  _ __ ___   __ _ _ __   __ _  __ _  ___ _ __ 
 * | '_ ` _ \ / _` | '_ \ / _` |/ _` |/ _ \ '__|
 * | | | | | | (_| | | | | (_| | (_| |  __/ |   
 * |_| |_| |_|\__,_|_| |_|\__,_|\__, |\___|_|   
 *                              |___/           
 */

state_t run_state(state_t cur_state, state_data_t *data) {
    state_t new_state = state_table[cur_state](data);
    if (new_state == NO_CHANGE)
        new_state = cur_state;

    return new_state;
}

#ifdef TEST_MAIN
#include <unistd.h>
int main() {
    state_t cur_state = STATE_INIT;

    do {
        cur_state = run_state(cur_state, NULL);
        sleep(1);

    } while (1);

    return 0;
}
#endif
